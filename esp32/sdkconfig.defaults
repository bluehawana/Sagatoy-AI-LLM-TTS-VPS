## esp32/sdkconfig.defaults.esp32s3
```kconfig
# ESP-IDF Version
set(ESP_IDF_VERSION "5.3")

# ESP32-S3 target
CONFIG_IDF_TARGET="esp32s3"

# Enable log output
CONFIG_LOG_DEFAULT_LEVEL_INFO=y
CONFIG_LOG_LEVEL=3

# ESP-TLS
CONFIG_ESP_TLS_USE_SECURE_ELEMENT=y
CONFIG_ESP_SYSTEM_EVENT_QUEUE_SIZE=64

# LWIP
CONFIG_LWIP_IPV4=y
CONFIG_LWIP_TCP_MSS=1460
CONFIG_LWIP_TCP_SND_BUF_DEFAULT=65536
CONFIG_LWIP_TCP_WND_DEFAULT=65536
CONFIG_WIFI_PROVISIONING_SCAN_MAX_ms=10000

# WiFi
CONFIG_WIFI_PROVISIONING_MANAGED_CHANNEL=y
CONFIG_WIFI_SOFTAP_SSID_MAX_LENGTH=32
CONFIG_ESP_WIFI_DYNAMIC_TX_BUFFER=y
CONFIG_ESP_WIFI_DYNAMIC_RX_BUFFER=y
CONFIG_ESP_WIFI_MGT_SUPPORT_PROV_ADV_INTERVAL=y
ESP_WIFI_MGB_ENABLED=y

# NVS
CONFIG_ESP_NVS_SECURE_ENTRY=y
CONFIG_NVS_ABERTION_THRESHOLD=0

# Secure Boot
CONFIG_SECURE_BOOT_ENABLED=n
CONFIG_SECURE_BOOT=n
CONFIG_SECURE_FLASH_ENC_ENABLED=n
```
